/ {
	amba_pl: amba_pl {
		ranges;
		compatible = "simple-bus";
		#address-cells = <1>;
		#size-cells = <1>;
		my_adder_ip_0: my_adder_ip@40000000 {
			compatible = "xlnx,my-adder-ip-1.0";
			xlnx,ii = <1>;
			xlnx,s-axi-control-addr-width = <6>;
			xlnx,machine = <64>;
			xlnx,rable = <0>;
			xlnx,ip-name = "my_adder_ip";
			reg = <0x40000000 0x10000>;
			clocks = <&clkc 15>;
			xlnx,clk-period = <10>;
			xlnx,s-axi-control-data-width = <32>;
			xlnx,edk-iptype = "PERIPHERAL";
			status = "okay";
			clock-names = "ap_clk";
			xlnx,combinational = <1>;
			xlnx,latency = <0>;
			xlnx,name = "my_adder_ip_0";
		};
	};
};
